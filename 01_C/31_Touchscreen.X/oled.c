/*
 * File: oled.c
 * Author: Armstrong Subero
 * PIC: 16F1717 w/Int OSC @ 16MHz, 5v
 * Program: Library file for SSD 1306 OLED
 * Compiler: XC8 (v1.38, MPLAX X v3.40)
 * Program Version: 1.1
 *                *Added additional comments
 *                
 * Program Description: This Library allows you to control the SSD 1306 OLED
 *                      
 * Created on March 10th, 2017, 8:05 PM
 */

#include "oled.h"
#include "I2C.h"
#include <string.h>


/*******************************************************************************
 * Function: const uint8_t OledFont[][8]
 *
 * Returns: Nothing
 *
 * Description: 2 Dimensional array containing the the ASCII characters
 * 
 ******************************************************************************/

const uint8_t OledFont[][8] =
{
  {0x00,0x00,0x00,0x00,0x00,0x00,0x00,0x00},
  {0x00,0x00,0x5F,0x00,0x00,0x00,0x00,0x00},
  {0x00,0x00,0x07,0x00,0x07,0x00,0x00,0x00},
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  {0x00,0x02,0x05,0x05,0x02,0x00,0x00,0x00},
};

/*******************************************************************************
 * Function: void OLED_Command( uint8_t temp)
 *
 * Returns: Nothing
 *
 * Description: sends commands to the OLED
 * 
 ******************************************************************************/

void OLED_Command( uint8_t temp){
    
    Send_I2C_StartBit();                    // send start bit
    Send_I2C_Data(0x3C << 1);            // send word address
    Send_I2C_Data(0x00);
    Send_I2C_Data(temp);             // send data byte
    Send_I2C_StopBit();                     // send stop bit
}

/*******************************************************************************
 * Function: void OLED_Data ( uint8_t temp)
 *
 * Returns: Nothing
 *
 * Description: sends data to the OLED
 * 
 ******************************************************************************/

void OLED_Data( uint8_t temp){
 
    Send_I2C_StartBit();                    // send start bit
    Send_I2C_Data(0x3C << 1);            // send word address
    Send_I2C_Data(0x40);
    Send_I2C_Data(temp);             // send data byte
    Send_I2C_StopBit();                     // send stop bit 
}

/*******************************************************************************
 * Function: void OLED_Init ()
 *
 * Returns: Nothing
 *
 * Description: Initializes OLED
 * 
 ******************************************************************************/

void OLED_Init() {
    
    OLED_Command(OLED_DISPLAYOFF);         // 0xAE
    OLED_Command(OLED_SETDISPLAYCLOCKDIV); // 0xD5
    OLED_Command(0x80);                    // the suggested ratio 0x80
    OLED_Command(OLED_SETMULTIPLEX);       // 0xA8
    OLED_Command(0x1F);
    OLED_Command(OLED_SETDISPLAYOFFSET);   // 0xD3
    OLED_Command(0x0);                        // no offset
    OLED_Command(OLED_SETSTARTLINE | 0x0); // line #0
    OLED_Command(OLED_CHARGEPUMP);         // 0x8D
    OLED_Command(0xAF);
    OLED_Command(OLED_MEMORYMODE);         // 0x20
    OLED_Command(0x00);                    // 0x0 act like ks0108
    OLED_Command(OLED_SEGREMAP | 0x1);
    OLED_Command(OLED_COMSCANDEC);
    OLED_Command(OLED_SETCOMPINS);         // 0xDA
    OLED_Command(0x02);
    OLED_Command(OLED_SETCONTRAST);        // 0x81
    OLED_Command(0x8F);
    OLED_Command(OLED_SETPRECHARGE);       // 0xd9
    OLED_Command(0xF1);
    OLED_Command(OLED_SETVCOMDETECT);      // 0xDB
    OLED_Command(0x40);
    OLED_Command(OLED_DISPLAYALLON_RESUME);// 0xA4
    OLED_Command(OLED_NORMALDISPLAY);      // 0xA6
    OLED_Command(OLED_DISPLAYON);          //--turn on oled panel

}

/*******************************************************************************
 * Function: void OLED_YX(unsigned char Row, unsigned char Column)
 *
 * Returns: Nothing
 *
 * Description: Sets the X and Y coordinates
 * 
 ******************************************************************************/

void OLED_YX(unsigned char Row, unsigned char Column)
{
    OLED_Command( 0xB0 + Row);
    OLED_Command( 0x00 + (8*Column & 0x0F) );
    OLED_Command( 0x10 + ((8*Column>>4)&0x0F) );
}

/*******************************************************************************
 * Function: void OLED_PutChar(char ch)
 *
 * Returns: Nothing
 *
 * Description: Writes a character to the OLED
 * 
 ******************************************************************************/

void OLED_PutChar( char ch )
{
    if ( ( ch < 32 ) || ( ch > 127 ) ){
        ch = ' ';
    }

    const uint8_t *base = &OledFont[ch - 32][0];

    uint8_t bytes[9];
    bytes[0] = 0x40;
    memmove( bytes + 1, base, 8 );
    
    Send_I2C_StartBit();                    // send start bit
    Send_I2C_Data(0x3C << 1);            // send word address
    Send_I2C_Data(0x40);
    
    int i;
    
    for (i = 1; i <= 8; i++){
         Send_I2C_Data(bytes[i]);
    }
    
    Send_I2C_StopBit();                     // send stop bit
}


/*******************************************************************************
 * Function: void OLED_Clear()
 *
 * Returns: Nothing
 *
 * Description: Clears the OLED
 * 
 ******************************************************************************/

void OLED_Clear()
{
    for ( uint16_t row = 0; row < 8; row++ ) {
        for ( uint16_t col = 0; col < 16; col++ ) {
            OLED_YX( row, col );
            OLED_PutChar(' ');
        }
    }
}


/*******************************************************************************
 * Function:  void OLED_Write_String( char *s )
 * 
 * Returns: Nothing
 *
 * Description: Writes a string to the OLED
 * 
 ******************************************************************************/

void OLED_Write_String( char *s )
{
    while (*s) OLED_PutChar( *s++);
}


/*******************************************************************************
 * Function:  void OLED_Write_Integer ( uint8_t i )
 * 
 * Returns: Nothing
 *
 * Description: Writes an integer to the OLED
 * 
 ******************************************************************************/

void OLED_Write_Integer(uint8_t i)
{
    char* buff11;
    int status;
    
    buff11 = itoa(&status, i, 10);
     
     
     OLED_Write_String(buff11);
     OLED_Write_String( "     " );
}

/*******************************************************************************
 * Function:  void OLED_Write_Float( float f )
 * 
 * Returns: Nothing
 *
 * Description: Writes a float to the OLED
 * 
 ******************************************************************************/

void OLED_Write_Float(float f)
{
    char* buf11;
    int status;

    buf11 = ftoa(f, &status);

    OLED_Write_String(buf11);
    OLED_Write_String( "     " );
}


// todo code
/********** prints out a pixel on the GLCD *******
void OLEDPixel ( int x, int y, char color )
{
	unsigned char *ptr;
	unsigned char page;
	unsigned int axisX;
	unsigned int axisY;
	signed char bitNumber, bitPlace;
	unsigned int address;
    
    #define ARRAY_WIDTH 128
    #define ARRAY_LENGHT 64
    #define ARRAY_HEIGHT 8
    #define OLED_COLUMN_ADDRESS 0x21
#define OLED_PAGE_ADDRESS 0x22
#define OLED_PAGE_START 0xB0
#define bitWise(n) ( 1 << n )

	if ( ( x < ARRAY_WIDTH && y <= ARRAY_LENGHT ) && 
		( x >= 0x00 && y >= 0x00 ) )
	{
		axisY = y / 8;							// Getting the row value.
		axisX = x;								// Getting the column value.
		page = abs ( axisY );					// Getting the Page number.
		bitNumber = ( y % 8 );					// Getting the bit value on the column.
		
        unsigned char TEST [ ARRAY_HEIGHT ] [ ARRAY_WIDTH ];
        

		int temp;
		temp =  y / 8;
		temp *= ARRAY_WIDTH;
		temp += x;
		ptr = ( char * ) TEST;

	// Set Column Address.
		OLED_Command ( OLED_COLUMN_ADDRESS );		
		OLED_Command ( axisX );					// Column start address.
		OLED_Command ( axisX );					// Column end address.
	// Set Page Address.
		OLED_Command ( OLED_PAGE_ADDRESS );		
		OLED_Command ( page );					// Page start Address.
		OLED_Command ( page );					// Page end Address.
		
		if ( color )	// bitSet ( x, x ) equivalent.
//			OLEDData ( *( ptr + temp ) |=  ( bitWise ( y % 8 ) ) );
			*( ptr + temp ) |=  ( bitWise ( y % 8 ) );

		else			// bitClear ( x, x ) equivalent.	
//			OLEDData ( *( ptr + temp ) &=  ~( bitWise ( y % 8 ) ) );
			*( ptr + temp ) &=  ~( bitWise ( y % 8 ) );

		}	// If the axies are whithin the OLED margin.
	}	// test Pixel.	
*/
